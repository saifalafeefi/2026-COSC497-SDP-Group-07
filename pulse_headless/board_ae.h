// board_ae.h -- the master's autoencoder, run on this board.
//
// ae_model.h is GENERATED by `python -m anomaly.board_ae_export` (not
// committed, 14 MB of C): the int8 model with its transpose convs and dense
// layers rewritten as plain convolutions -- same math, no retraining -- so
// every layer has an ESP-NN kernel. TFLite Micro ships with the Arduino core
// 3.3.x. Measured on a Rev F board: 256 ms a window with the model in PSRAM,
// output bit-exact with TFLite's reference kernels on the PC.
//
// It runs in its own task on core 0, below WiFi and AsyncTCP, alongside the
// board's detector: the detector hands it the same cleaned 60 s window it
// scores itself, at most once every AE_PERIOD_MS, and reads the result back.
// Nothing here issues a verdict.
//
// Needs PSRAM (model copy + arena) and the big-app partition table beside the
// sketch (partitions.csv): the model is 4.2 MB.
#pragma once

#include <Arduino.h>
#include <esp_heap_caps.h>
#include <math.h>

#include "tensorflow/lite/micro/micro_interpreter.h"
#include "tensorflow/lite/micro/micro_mutable_op_resolver.h"
#include "tensorflow/lite/schema/schema_generated.h"

#include "ae_model.h"

#define AE_PERIOD_MS   5000          // one window every 5 s: ~2 min of a 150 mAh charge
#define AE_ARENA_BYTES (384 * 1024)  // measured need 258 KB; PSRAM
#define AE_STACK       12288         // uses ~2.5 KB (aestk); internal RAM is scarce with Bluetooth on
#define AE_FRESH_MS    12000         // older than this, the score is not used

// results, written by the AE task, read anywhere
volatile bool aeReady = false;       // model loaded AND self-test passed
char aeSelf[96] = "not run";
volatile float aeScore = NAN;        // reconstruction MSE, the master's AE units
volatile uint32_t aeAtMs = 0;        // when that score was finished
volatile uint32_t aeWear = 0;        // the wear (bdFrom) its window came from
volatile uint32_t aeMs = 0;          // what the last run cost, prep + invoke
volatile uint32_t aeRuns = 0;
volatile uint32_t aeStackFree = 0;   // bytes never touched on the task's stack
volatile bool aeInPsram = false;     // model copied to PSRAM (else read from flash)

// the request: one window in flight at a time
static float *aeIn = NULL;           // AE_WIN floats, PSRAM
static volatile bool aeBusy = false;
static volatile uint32_t aeReqWear = 0;
static uint32_t aeLastReq = 0;
static TaskHandle_t aeTaskH = NULL;

static tflite::MicroInterpreter *aeInterp = NULL;

static inline int8_t ae__q(float x) {
  // numpy rounds half to even; nearbyintf does too in the default rounding mode
  float q = nearbyintf(x / AE_IN_SCALE) + (float)AE_IN_ZP;
  if (q < -128.0f) q = -128.0f;
  if (q > 127.0f) q = 127.0f;
  return (int8_t)q;
}

// anomaly.infer.LiveAnomalyDetector.score: z-score, quantise, run, MSE of the
// dequantised reconstruction against the z-scored float window
static float ae__score(const float *win) {
  double mean = 0.0, var = 0.0;
  for (int i = 0; i < AE_WIN; i++) mean += win[i];
  mean /= AE_WIN;
  for (int i = 0; i < AE_WIN; i++) var += ((double)win[i] - mean) * ((double)win[i] - mean);
  float sd = (float)sqrt(var / AE_WIN) + 1e-8f;
  float mu = (float)mean;
  TfLiteTensor *in = aeInterp->input(0);
  for (int i = 0; i < AE_WIN; i++) in->data.int8[i] = ae__q((win[i] - mu) / sd);
  if (aeInterp->Invoke() != kTfLiteOk) return NAN;
  const int8_t *r = aeInterp->output(0)->data.int8;
  double se = 0.0;
  for (int i = 0; i < AE_WIN; i++) {
    float x = (win[i] - mu) / sd;
    float d = (float)(r[i] - AE_OUT_ZP) * AE_OUT_SCALE - x;
    se += (double)d * d;
  }
  return (float)(se / AE_WIN);
}

static bool ae__load() {
  const uint8_t *m = ae_model;
  uint8_t *ps = (uint8_t *)heap_caps_aligned_alloc(16, ae_model_len, MALLOC_CAP_SPIRAM | MALLOC_CAP_8BIT);
  if (ps) {                          // 256 ms a window from PSRAM, 337 ms from flash
    memcpy(ps, ae_model, ae_model_len);
    m = ps;
    aeInPsram = true;
  }
  uint8_t *arena = (uint8_t *)heap_caps_aligned_alloc(16, AE_ARENA_BYTES, MALLOC_CAP_SPIRAM | MALLOC_CAP_8BIT);
  aeIn = (float *)heap_caps_malloc(AE_WIN * sizeof(float), MALLOC_CAP_SPIRAM | MALLOC_CAP_8BIT);
  if (arena == NULL || aeIn == NULL) {
    snprintf(aeSelf, sizeof(aeSelf), "off: no PSRAM for the arena");
    return false;
  }
  const tflite::Model *model = tflite::GetModel(m);
  if (model->version() != TFLITE_SCHEMA_VERSION) {
    snprintf(aeSelf, sizeof(aeSelf), "fail: schema %lu", (unsigned long)model->version());
    return false;
  }
  static tflite::MicroMutableOpResolver<4> resolver;   // what board_ae_export allows
  resolver.AddConv2D();
  resolver.AddReshape();
  resolver.AddConcatenation();
  resolver.AddAdd();
  aeInterp = new tflite::MicroInterpreter(model, resolver, arena, AE_ARENA_BYTES);
  if (aeInterp->AllocateTensors() != kTfLiteOk) {
    snprintf(aeSelf, sizeof(aeSelf), "fail: arena too small");
    return false;
  }
  TfLiteTensor *in = aeInterp->input(0), *out = aeInterp->output(0);
  if (in->type != kTfLiteInt8 || out->type != kTfLiteInt8 ||
      in->bytes != AE_WIN || out->bytes != AE_WIN ||
      fabsf(in->params.scale - AE_IN_SCALE) > 1e-6f * AE_IN_SCALE || in->params.zero_point != AE_IN_ZP ||
      fabsf(out->params.scale - AE_OUT_SCALE) > 1e-6f * AE_OUT_SCALE || out->params.zero_point != AE_OUT_ZP) {
    snprintf(aeSelf, sizeof(aeSelf), "fail: model io does not match ae_model.h");
    return false;
  }
  // self-test: a real WESAD window, against what TFLite's reference kernels
  // computed for it on the PC. ESP-NN matched them exactly in the bench.
  memcpy(in->data.int8, ae_test_in, AE_WIN);
  uint32_t t0 = millis();
  if (aeInterp->Invoke() != kTfLiteOk) {
    snprintf(aeSelf, sizeof(aeSelf), "fail: invoke");
    return false;
  }
  uint32_t ms = millis() - t0;
  int worst = 0;
  for (int i = 0; i < AE_WIN; i++) {
    int d = abs((int)out->data.int8[i] - (int)ae_test_out[i]);
    if (d > worst) worst = d;
  }
  snprintf(aeSelf, sizeof(aeSelf), "%s: max|out-ref| %d LSB, %lu ms, arena %u B, model in %s",
           worst <= 1 ? "pass" : "fail", worst, (unsigned long)ms,
           (unsigned)aeInterp->arena_used_bytes(), aeInPsram ? "PSRAM" : "flash");
  return worst <= 1;
}

static void aeTask(void *) {
  bool ok = ae__load();
  Serial.print("# autoencoder ");
  Serial.print(AE_MODEL_TAG);
  Serial.print(" self-test ");
  Serial.println(aeSelf);
  aeStackFree = uxTaskGetStackHighWaterMark(NULL);
  if (!ok) {                         // one that disagrees with its reference stays off
    vTaskDelete(NULL);
    return;
  }
  aeReady = true;
  for (;;) {
    ulTaskNotifyTake(pdTRUE, portMAX_DELAY);
    uint32_t t0 = millis();
    float s = ae__score(aeIn);
    aeMs = millis() - t0;
    aeWear = aeReqWear;
    aeScore = s;
    __sync_synchronize();
    aeAtMs = millis();
    aeRuns = aeRuns + 1;
    aeStackFree = uxTaskGetStackHighWaterMark(NULL);
    aeBusy = false;
  }
}

void aeBegin() {
  // core 0, priority 1: beside the board's detector, below WiFi and AsyncTCP
  xTaskCreatePinnedToCore(aeTask, "ae", AE_STACK, NULL, 1, &aeTaskH, 0);
}

// From the detector task: a cleaned window is ready. Taken at most once every
// AE_PERIOD_MS, and never while the last one is still running.
void aeRequest(const float *win, uint32_t wear) {
  if (!aeReady || aeBusy) return;
  uint32_t now = millis();
  if (aeLastReq != 0 && now - aeLastReq < AE_PERIOD_MS) return;
  aeLastReq = now;
  memcpy(aeIn, win, AE_WIN * sizeof(float));
  aeReqWear = wear;
  aeBusy = true;
  xTaskNotifyGive(aeTaskH);
}

// the latest score if it is recent and from this wear, else NAN
float aeLatest(uint32_t wear) {
  uint32_t at = aeAtMs;
  __sync_synchronize();
  if (at == 0 || aeWear != wear || millis() - at > AE_FRESH_MS) return NAN;
  return aeScore;
}
